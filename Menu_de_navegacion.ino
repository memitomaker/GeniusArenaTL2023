//  Codigo para la utilizacion de pantalla OLED con driver 1306
#include <Wire.h>
#include <Adafruit_GFX.h>
#include <Adafruit_SSD1306.h>

/* pines de entrada,
   36 = capacitor
   39 = resistor
   34 = voltaje
   35 = bateria
   32 = led  */
const int cap = 36;
const int res = 39;
const int volt = 34;
const int bat = 35;
const int led = 32;
const int btn = 2;
float  vbat = 0;
float res_bat = 0;
float porcentaje = 0;
float porcentaje2 = 0;
float voltaje = 0;
float res_volt = 0;
float res_volt1 = 0;
int i = 0;
int j = 0;
int n = 50;
long vbat2 = 0;
int push = 0;
byte menuCount = 1;


#define SCREEN_WIDTH 128 // OLED display width,  in pixels
#define SCREEN_HEIGHT 64 // OLED display height, in pixels

// declare an SSD1306 display object connected to I2C
Adafruit_SSD1306 oled(SCREEN_WIDTH, SCREEN_HEIGHT, &Wire, -1);

static const unsigned char PROGMEM datos_imagen[414] = {
  0x00, 0x00, 0x00, 0x00, 0x00, 0x00, 0x00, 0x00, 0x00,
  0x7f, 0xff, 0xff, 0x03, 0xff, 0x07, 0xff, 0xff, 0xf8,
  0x7f, 0xff, 0xfc, 0x01, 0xfe, 0x00, 0xff, 0xff, 0xf8,
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  0x7f, 0xef, 0xff, 0xff, 0xff, 0xff, 0xff, 0x9f, 0xf8
};


void setup() {
  pinMode(led, OUTPUT);
  pinMode(btn, INPUT);
  Serial.begin(9600);
  // initialize OLED display with address 0x3C for 128x64
  if (!oled.begin(SSD1306_SWITCHCAPVCC, 0x3C)) {
    Serial.println(F("SSD1306 allocation failed"));
    while (true);
  }
  delay(2000);         // wait for initializing
  oled.clearDisplay(); // clear display
  oled.setTextSize(1);          // text size
  oled.setTextColor(WHITE);     // text color
  oled.setCursor(30, 0 );       // position to display
  oled.println("Predatronics");
  oled.drawBitmap(29, 18, datos_imagen, 69, 46, SSD1306_WHITE);
  //oled.setCursor(50,20 );        // position to display
  //oled.println("<3");
  //oled.setCursor(15,30 );        // position to display
  //oled.println(" Voltimetro  ");
  // text to display
  oled.display();
  delay(2500);// show on OLED
  for (int k = 0; k <= 3; k++) {
    blynk();
  }
}

void loop() {
  push = digitalRead(btn);
  menuCheck();
  staticMenu();
}
void leer_bat() {
  for (int i = 0; i < n; i++)
  {
    vbat = vbat + analogRead(bat);
  }
  delay(10);
  vbat2 = vbat / n;
  res_bat = ((vbat2 * 2.1) / 2432);
  delay(1);
  porcentaje = (((res_bat - 1.65) * 100) / 0.44);
  if (porcentaje > 100) {
    porcentaje = 100;
  }
  delay(1);
  vbat = 0;
}
void staticMenu() {
  leer_bat();
  oled.clearDisplay();
  oled.setCursor(65, 0);
  oled.println("Bat-");
  oled.setCursor(90, 0);
  oled.println(porcentaje);
  oled.setCursor(120, 0);
  oled.println("%");
  oled.setCursor(10, 0);
  oled.println(" :) ");
  //---------------------------------
  oled.setTextSize(1);
  oled.setCursor(10, 20);
  oled.println("No sensar");
  oled.setCursor(10, 30);
  oled.println("Voltaje");
  if (menuCount == 2) {
    //for (int l = 0; l < n; l++)
    //{
    voltaje = analogRead(volt);
    Serial.println(voltaje);
    //}
    //delay(1);
    //res_volt = voltaje / n;
    if (voltaje > 100) {
      res_volt1 = (((voltaje * (3.3)) / 2048) * 17.3703) - 0.78;
    }
    if ((voltaje < 100) && (voltaje > 5)) {
      res_volt1 = (((voltaje * (3.3)) / 2048) * 17.3703) + 0.78;
    }
    if (voltaje < 5) {
      voltaje = 0;
    }
    oled.setCursor(70, 30);
    oled.println("=");
    oled.setCursor(80, 30);
    oled.println(res_volt1);
    voltaje = 0;
  }
  oled.setCursor(10, 40);
  oled.println("Resistor");
  oled.setCursor(10, 50);
  oled.println("Capacitor");
  oled.setCursor(2, (menuCount * 10) + 10);
  oled.println(">");
  oled.display();
  delay(100);
}
void menuCheck() {
  if (push == LOW) {
    menuCount++;
    blynk();
    if (menuCount == 1) {
      res_volt1 = 0;
    }
    if (menuCount >= 5) {
      menuCount = 1;
      res_volt1 = 0;
    }
  }

}
void blynk()
{
  digitalWrite(led, HIGH);
  delay(100);
  digitalWrite(led, LOW);
  delay(50);
}
